#define CONFIG_WIRELESS
#define ZMK_BASE_LAYER(name, LT, RT, LM, RM, LB, RB, LH, RH)                   \
    ZMK_LAYER(                                                                 \
        name,                                                                  \
                &kp N1 LT RT &kp N4                                            \
                &kp N2 LM RM &kp N5                                            \
                &kp N3 LB RB &kp N6                                            \
              &kp LGUI LH RH &smart_mouse                                      \
    )

#include "zmk-helpers/key-labels/42.h"
#include "base.keymap"

/{ chosen { zmk,physical-layout = &foostan_corne_5col_layout; }; };
